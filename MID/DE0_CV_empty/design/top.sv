
//=======================================================
//  This code is generated by Terasic System Builder
//=======================================================

module top(
	input logic clk,
	input logic rst,
	input logic a,b,c,
	output logic [3:0] count_a,
	output logic [2:0] crosswalk_light,
    output logic [2:0] road_light
	);

logic trg_a, trg_b, trg_c;
arbiter arbiter_u1(
	.clk(clk),
	.rst(rst),
	.a(a),
	.b(b),
	.c(c),
	.trg_a(trg_a), 
	.trg_b(trg_b), 
	.trg_c(trg_c)
);

logic dff_a;
logic dff_b;
logic dff_c;
logic mod_a_ok, mod_c_ok;
always_ff @(posedge clk or negedge rst)
begin
    if (trg_a == 1)
        dff_a = 1;
	else if(mod_a_ok)
		dff_a = 0;

    
    if (trg_c == 1)
        dff_c = 1;
	else if(mod_c_ok)
		dff_c = 0;
end

//=======================================================
//  REG/WIRE declarations
//=======================================================

mod_a mod_a_u1(
	.clk(clk),
	.rst(rst),
	.trg_a(dff_a),
	.count_a(count_a),
	.ok(mod_a_ok)
);
	

//=======================================================
//  Structural coding
//=======================================================

mod_c mod_c_u1(
    .crosswalk_light(crosswalk_light),
    .road_light(road_light),
    .clk(clk),
    .reset(rst),
    .trg_c(dff_c),
	  .ok(mod_c_ok)
    );


endmodule
